## buildroot-external/package/nvidia-container-toolkit/Config.in
```kconfig
config BR2_PACKAGE_NVIDIA_CONTAINER_TOOLKIT
	bool "NVIDIA Container Toolkit"
	depends on BR2_PACKAGE_HOST_GO_TARGET_ARCH_SUPPORTS
	depends on BR2_PACKAGE_HOST_GO_TARGET_CGO_LINKING_SUPPORTS
	depends on BR2_PACKAGE_NVIDIA_OPEN_DRIVER
	help
	  nvidia-ctk and nvidia-cdi-hook. They generate the Container
	  Device Interface (CDI) specification for the installed NVIDIA
	  driver, which Docker uses to pass the GPU to containers.

	  Installed into the "nvidia" system extension.

	  https://github.com/NVIDIA/nvidia-container-toolkit
```

## buildroot-external/package/nvidia-legacy-driver/Config.in
```kconfig
config BR2_PACKAGE_NVIDIA_LEGACY_DRIVER
	bool "NVIDIA GPU driver for Maxwell to Volta (system extension)"
	depends on BR2_x86_64
	depends on BR2_LINUX_KERNEL
	depends on BR2_TOOLCHAIN_BUILDROOT_GLIBC # ldconfig
	select BR2_PACKAGE_HOST_EROFS_UTILS
	help
	  NVIDIA driver 580 with the proprietary kernel modules for
	  GPUs the open kernel modules don't support: Maxwell
	  (GTX 9xx), Pascal (GTX 10xx, Tesla P4/P40/P100) and Volta.
	  It contains the same user space as the "nvidia" extension.

	  Packaged as a system extension for the OS variant
	  "nvidia-legacy" (haos_<board>-nvidia-legacy-<version>).

comment "NVIDIA legacy GPU driver needs the Buildroot glibc toolchain and a Linux kernel"
	depends on BR2_x86_64
	depends on !BR2_LINUX_KERNEL || !BR2_TOOLCHAIN_BUILDROOT_GLIBC
```

## buildroot-external/package/nvidia-open-driver/Config.in
```kconfig
config BR2_PACKAGE_NVIDIA_OPEN_DRIVER
	bool "NVIDIA GPU driver (system extension)"
	depends on BR2_x86_64
	depends on BR2_LINUX_KERNEL
	depends on BR2_TOOLCHAIN_BUILDROOT_GLIBC # ldconfig
	select BR2_PACKAGE_HOST_EROFS_UTILS
	help
	  NVIDIA open GPU kernel modules together with the matching
	  CUDA/NVML/NVENC/NVDEC user space libraries, nvidia-smi and
	  the GSP firmware.

	  Due to its size, the driver is not installed into the root
	  file system. It is packaged as a systemd system extension
	  and builds the OS variant "nvidia": its disk image and update
	  bundle (haos_<board>-nvidia-<version>) place the extension
	  on the data partition, and it is merged into /usr at boot.
	  The extension is bound to the exact OS build it was built
	  with, so kernel modules and user space always match.

	  Requires a Turing (GTX 16xx / RTX 20xx) or newer GPU. Older
	  GPUs need nvidia-legacy-driver.

	  https://github.com/NVIDIA/open-gpu-kernel-modules

comment "NVIDIA GPU driver needs the Buildroot glibc toolchain and a Linux kernel"
	depends on BR2_x86_64
	depends on !BR2_LINUX_KERNEL || !BR2_TOOLCHAIN_BUILDROOT_GLIBC
```
